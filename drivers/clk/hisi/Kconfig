## drivers/clk/hisi/Kconfig
```kconfig
config HISI_CLK
	bool "clock driver of Soc"
	default n

config HISI_CLK_ALWAYS_ON
	bool "all clocks of Hisi Soc are always on"
	default n

config HISI_CLK_PM_MONITOR
	bool "clock pm_monitor spec"
	default n

config HISI_CLK_KIRIN
        bool "boston and the version behind of boston clock spec"
        default n

config HISI_CLK_MAILBOX_SUPPORT
	depends on HISI_CLK
	depends on HISI_MAILBOX
	bool "clk driver support mailbox communication"
	default n

config HISI_CLK_DEBUG
	depends on DEBUG_FS
	bool "HiSilicon clock driver debug"
	default n
```

## drivers/contexthub/swing/Kconfig
```kconfig
config CONTEXTHUB_SWING
	bool "swing driver"
	depends on INPUTHUB_20
	default n
	help
	Swing driver support aonn.

config CONTEXTHUB_SWING_DBG
	bool "swing dbg drvier"
	depends on INPUTHUB_20
	default n
	help
	Swing debug drvier support aonn.
```

## drivers/huawei_platform/power/charger/charger_ap/wireless_charger/dual_sc/Kconfig
```kconfig
#
# huawei dual sc device drivers
#

config WIRELESS_DUAL_SC
	bool "wireless_dual sc"
	default n
	help
	  Say Y here to enable dual_sc driver.
	  The dual_sc is an soc for wireless charge-pump converter.
	  It is fully compliant with the latest Qi receiver to make
	  the input current to be half the current delivered to the output.

config WIRELESS_DUAL_SC_CP_HL1506
	bool "WIRELESS_DUAL_SC_CP_HL1506"
	depends on WIRELESS_DUAL_SC
	default n
	help
	  Say Y here to enable dual cp_hl1506 driver.
	  The hl1506 is an soc for wireless charge-pump converter.
	  It is fully compliant with the latest Qi receiver to make
	  the input current to be half the current delivered to the output.
```
